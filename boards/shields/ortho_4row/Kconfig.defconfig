## boards/shields/ortho_4row/Kconfig.defconfig
```kconfig
if SHIELD_ORTHO_4ROW_RIGHT

config ZMK_KEYBOARD_NAME
    default "ortho_4row"

endif

if SHIELD_ORTHO_4ROW_LEFT || SHIELD_ORTHO_4ROW_RIGHT

config ZMK_SPLIT
    default y

endif

if SHIELD_ORTHO_4ROW_RIGHT

config ZMK_POINTING
    default y

config PAW3222
    default y

endif
```

## boards/shields/ortho_4row/Kconfig.shield
```kconfig
config SHIELD_ORTHO_4ROW_LEFT
    def_bool $(shields_list_contains,ortho_4row_left)
config SHIELD_ORTHO_4ROW_RIGHT
    def_bool $(shields_list_contains,ortho_4row_right)
```
